#include <Arduino.h>
#include <WiFi.h>
#include <Firebase_ESP_Client.h>
#include "addons/TokenHelper.h"
#include "addons/RTDBHelper.h"

#define WIFI_SSID "iPhone"
#define WIFI_PASSWORD "12345678"

#define API_KEY "AIzaSyAXINmBHzgSSWfuVgMyQ35c_KGADKa_F1U"
#define DATABASE_URL "https://co2-sensing-87192-default-rtdb.firebaseio.com/"

// Define Firebase Data object
FirebaseData fbdo;
FirebaseAuth auth;
FirebaseConfig config;

unsigned long sendDataPrevMillis = 0;
int count = 0;
bool signupOK = false;

// For OLED LCD Display
#include <Adafruit_GFX.h>
#include <Adafruit_SSD1306.h>
// BME280 Environmental Sensor Imports
// This sensor can sense temperature, humidity, and air pressure. However for this project
// we will only be keeping track of temperature and humidity.
#include <Wire.h>
#include <SPI.h>
#include <Adafruit_BME280.h>
#include <Adafruit_Sensor.h>
// For RGB LED
#include <FastLED.h>

// On-board RGB LED setup
#define NUM_LEDS 1        // The ESP32 has 1 RGB LED
#define RGB_DATA_PIN D8   // The pin for controlling the RGB LED
#define LED_TYPE NEOPIXEL // RGB LED strip type
#define BRIGHTNESS 35
CRGB leds[NUM_LEDS];

void set_rgb_led_color(float concentration) {
  if (concentration == -1.0) {      // Fault
    FastLED.clear();                // No light
    return;
  }
  else if (concentration == 0.0) {  // Preheating
    leds[0] = CRGB(229, 255, 0);    // Yellow
    FastLED.show();
    return;
  }
  else if (concentration == 1.0) {  // Outside range
    leds[0] = CRGB(230, 0, 255);    // Purple
    FastLED.show();
    return;
  }

  if (concentration >= 1600) {
    leds[0] = CRGB(255, 0, 0);
    FastLED.show();
    return;
  }
  // Smoothly select a color. Concentrations of 1599 will have a red light
  // while concentrations closer to 400 will have a green hue.
  int smooth_selection_value = ((-255.0/1249.0) * concentration) + 326.0;

  int r = 255 - smooth_selection_value;
  int g = 0 + smooth_selection_value;
  int b = 0;
  
  Serial.printf("The rgb value is (%d, %d, %d)\n", r, g, b);

  leds[0] = CRGB(r, g, b);
  FastLED.show();
}

// OLED Screen Setup
#define SCREEN_WIDTH 128
#define SCREEN_HEIGHT 64
#define OLED_RESET -1  // Reset pin # (-1 if sharing Arduino reset pin)
Adafruit_SSD1306 display(SCREEN_WIDTH, SCREEN_HEIGHT, &Wire, OLED_RESET);  // Declaration for an SSD1306 display connected to I2C (SDA, SCL pins)

// This is an array that displays a splash screen that contains a logo and the text
// "CO2 sensor" below. It appears briefly when the device is powered on.
const unsigned char splash [] PROGMEM = {
  0x00, 0x00, 0x00, 0x00, 0x00, 0x00, 0x00, 0x00, 0x00, 0x00, 0x00, 0x00, 0x00, 0x00, 0x00, 0x00, 
  0x00, 0x00, 0x00, 0x00, 0x00, 0x00, 0x00, 0x00, 0x00, 0x00, 0x00, 0x00, 0x00, 0x00, 0x00, 0x00, 
  0x00, 0x00, 0x00, 0x00, 0x00, 0x00, 0x00, 0x00, 0x00, 0x00, 0x00, 0x00, 0x00, 0x00, 0x00, 0x00, 
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  0x00, 0x00, 0x00, 0x00, 0x00, 0x00, 0x00, 0x00, 0x00, 0x00, 0x00, 0x00, 0x00, 0x00, 0x00, 0x00
};

// CO2 Sensor Code
// Infrared CO2 Sensor range : 400-4980ppm
// ON ESP32, the interrupt pin is D7. Other non-conflicting pins can also be selected as external interrupt pins.
// This is where the signal of the CO2 sensor is plugged in. 
#define SENSOR_DATA_PIN   (D7)   // Sensor PWM interface
#define INTERRUPT_NUMBER   digitalPinToInterrupt(SENSOR_DATA_PIN)   // interrupt number
#define VOLTAGE 3.3
// Used in interrupt, calculate pulse width variable
volatile unsigned long pwmHighStartTicks=0, pwmHighEndTicks=0;
volatile unsigned long pwmHighVal=0, pwmLowVal=0;
// interrupt flag
volatile uint8_t flag=0;

void interruptChange()
{
  if (digitalRead(SENSOR_DATA_PIN)) {
    pwmHighStartTicks = micros();    // store the current micros() value
    if(2 == flag){
      flag = 4;
      if(pwmHighStartTicks > pwmHighEndTicks) {
        pwmLowVal = pwmHighStartTicks - pwmHighEndTicks;
      }
    }else{
      flag = 1;
    }
  } else {
    pwmHighEndTicks = micros();    // store the current micros() value
    if(1 == flag){
      flag = 2;
      if(pwmHighEndTicks > pwmHighStartTicks){
        pwmHighVal = pwmHighEndTicks - pwmHighStartTicks;
      }
    }
  }
}


// Function that gets the CO2 concentration using pulse width modulation (PWM)
// Returns a float
// Returns concentration if the CO2 concentration is in the normal range (300-5000ppm)
// Returns -1.0 if there is a Fault
// Returns 0.0 if the sensor is preheating
// Returns 1.0 if the sensor is outside of the normal range
float getCO2Concentration() {
  float concentration;
    flag = 1;
    float pwmHighVal_ms = (pwmHighVal * 1000.0) / (pwmLowVal + pwmHighVal);
    if (pwmHighVal_ms < 0.01){
      concentration = -1.0;   // Fault. No or very little signal being received.
    }
    else if (pwmHighVal_ms < 80.00){
      concentration = 0.0;    // Preheating
    }
    else if (pwmHighVal_ms < 998.00){
      concentration = (pwmHighVal_ms - 2) * VOLTAGE;
    } else {
      concentration = 1.0;    // Outside of range
    }
  return concentration;
}

// BME280 Setup
Adafruit_BME280 bme; // use I2C interface
Adafruit_Sensor *bme_temp = bme.getTemperatureSensor();
Adafruit_Sensor *bme_pressure = bme.getPressureSensor();
Adafruit_Sensor *bme_humidity = bme.getHumiditySensor();
sensors_event_t temp_event, pressure_event, humidity_event;


void setup() {
  // Set the data rate in bits-per-second to establish serial communication
  Serial.begin(115200);
  Serial.println("beginning...");

  // ---------WIFI SETUP-----------------
  WiFi.begin(WIFI_SSID, WIFI_PASSWORD);
  Serial.print("Connecting to Wi-Fi");
  while (WiFi.status() != WL_CONNECTED) {
    Serial.print(".");
    delay(300);
  }
  Serial.println();
  Serial.print("Connected with IP: ");
  Serial.println(WiFi.localIP());
  Serial.println();
  // --------FIREBASE SETUP---------------
  config.api_key = API_KEY;
  config.database_url = DATABASE_URL;
  // Sign up
  if (Firebase.signUp(&config, &auth, "", "")) {
    Serial.println("ok");
    signupOK = true;
  }
  else {
    Serial.printf("%s\n", config.signer.signupError.message.c_str());
  }
  /* Assign the callback function for the long running token generation task */
  config.token_status_callback = tokenStatusCallback; //see addons/TokenHelper.h
  Firebase.begin(&config, &auth);
  Firebase.reconnectWiFi(true);

  // Setup RGB LED
  FastLED.addLeds<LED_TYPE, RGB_DATA_PIN>(leds, NUM_LEDS); // Initialize RGB LED
  FastLED.setBrightness(BRIGHTNESS);

  // Set the pin to read input from the CO2 sensor
  pinMode(SENSOR_DATA_PIN, INPUT);
  // This interrupt will be triggered whenever there is a change in the value
  // of the SENSOR_DATA_PIN. In the context of PWM, this means a rising or
  // falling edge of the PWM signal.
  attachInterrupt(INTERRUPT_NUMBER, interruptChange, CHANGE);

  // Setup BME Sensor
    if (!bme.begin()) {
    Serial.println(F("Could not find a valid BME280 sensor, check wiring!"));
    while (1) {
      // Flash Between light blue and green
      leds[0] = CRGB(52, 207, 235);
      FastLED.show();
      delay(5);
      leds[0] = CRGB(52, 207, 235);
      FastLED.show();
      delay(5);
    }
  }
  // Prints sensor details to the serial monitor.
  bme_temp->printSensorDetails();
  bme_pressure->printSensorDetails();
  bme_humidity->printSensorDetails();

  // Display Setup
  if(!display.begin(SSD1306_SWITCHCAPVCC, 0x3C))                     //Connect to the OLED display
  {
    Serial.println(F("SSD1306 allocation failed"));                  //If connection fails
    leds[0] = CRGB(8, 0, 255);
    FastLED.show();
    for(;;);                                                         //Don't proceed, loop forever
  }
  display.clearDisplay();                                            //Clear the display
  display.setTextColor(SSD1306_WHITE);                               //Set the text colour to white
  display.drawBitmap(0, 0, splash, 128, 64, WHITE);                  //Display bitmap from array
  display.setTextSize(1);                                            //Set the text size
  display.setCursor(30,50);
  display.print(F("Air Quality"));
  display.display();
  delay(5000);
}

void loop() {
  if (flag == 4) {
    display.clearDisplay();           //Clear display
    display.setCursor(31,4);          
    display.print(F("Measurements"));  // Write "Measurements" at the top of the screen

    // Get and display CO2 concentration
    display.setCursor(15,16);
    display.print(F("CO2: "));
    display.setCursor(60,16);
    float concentration = getCO2Concentration();
    set_rgb_led_color(concentration);
    Serial.print(concentration);    // Print to serial
    Serial.println(" ppm");
    // Handle special cases first
    if (concentration == -1.0) {          // Fault
    
      display.print(F("ERROR"));
    } else if (concentration == 0.0) {    // Preheating
      Serial.println("Sensor preheating. Please wait.");
      display.print(F("Preheating"));

    } else if (concentration == 1.0) {   // Out of range (OOR)
      Serial.println("Beyond the maximum range : 398~4980ppm");
      display.print(F("Range"));
    } else {
      display.print(concentration);   // Show on OLED display
      display.print(F("ppm"));
    }

    // Get and display temperature
    bme_temp->getEvent(&temp_event);
    display.setCursor(15,32);
    Serial.print("Temperature: ");
    Serial.print(temp_event.temperature);    // Print to serial
    Serial.println("*C");
    display.print(F("Temp: "));     // Show on OLED display
    display.setCursor(60,32);
    display.print(temp_event.temperature);
    display.print(F("*C"));

    // Get and display humidity
    bme_humidity->getEvent(&humidity_event);
    display.setCursor(15,48);
    Serial.print("Humidity: ");
    Serial.print(humidity_event.relative_humidity);    // Print to serial
    Serial.println(" %");
    display.print(F("Humidity: "));          // Show on OLED display
    display.setCursor(80,48);
    display.print(humidity_event.relative_humidity);
    display.print(F(" %"));

    // Now that we have all the readings, go ahead and update Firebase
    if (Firebase.ready() && signupOK) {
      if (Firebase.RTDB.setFloat(&fbdo, "/co2_concentration", concentration)) {
        Serial.println("PASSED");
        Serial.println("PATH: " + fbdo.dataPath());
        Serial.println("TYPE: " + fbdo.dataType());
      }
      else {
        Serial.println("FAILED");
        Serial.println("REASON: " + fbdo.errorReason());
      }
      Firebase.RTDB.setFloat(&fbdo, "/temperature", temp_event.temperature);
      Firebase.RTDB.setFloat(&fbdo, "/humidity", humidity_event.relative_humidity);
    }
    else {
      Serial.println("Firebase not ready");
    }
    
    // // Get and display air pressure
    // bme_pressure->getEvent(&pressure_event);
    // display.setCursor(15,24);
    // Serial.print("Pressure: ");
    // Serial.print(pressure_event.pressure);    // Print to serial
    // Serial.println(" hPa");
    // display.print(F("Pressure: "));          // Show on OLED display
    // display.setCursor(60,24);
    // display.print(humidity_event.relative_humidity);
    // display.print(F(" hpa"));

    Serial.println();
    display.display();
    delay(1000);
  }
}




